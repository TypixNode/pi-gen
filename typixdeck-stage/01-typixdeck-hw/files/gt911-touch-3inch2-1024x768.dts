/dts-v1/;

/ {
	compatible = "brcm,bcm2708", "brcm,bcm2711", "brcm,bcm2712";

	// 背光已从本 overlay 移除（原 fragment@0 的 gpio-backlight @GPIO18）：
	// PWM 调光由独立 overlay 提供——CM5 用 pwm-backlight-3inch2-rp1，
	// CM0/CM3/CM4 用 pwm-backlight-3inch2-bcm（config.txt 按 [cm5]/[cm4]/[pi0] 分段加载）。
	// 同一 GPIO 不能同时被 gpio-backlight 和 pwm-backlight 两个驱动认领。

	fragment@1 {
		target-path = "/";

		__overlay__ {

			i2c@0 {
				compatible = "i2c-gpio";
				gpios = <0xffffffff 0x0a 0x00 0xffffffff 0x0b 0x00>;
				i2c-gpio,delay-us = <0x04>;
				#address-cells = <0x01>;
				#size-cells = <0x00>;
				phandle = <0x01>;
			};
		};
	};

	fragment@2 {
		target = <0x01>;

		__overlay__ {
			#address-cells = <0x01>;
			#size-cells = <0x00>;

			ft6236@14 {
				compatible = "goodix,gt911";
				reg = <0x14>;
				interrupt-parent = <0xffffffff>;
				interrupts = <0x1b 0x02>;
				irq-gpios = <0xffffffff 0x1b 0x02>;
				touchscreen-size-x = <0x400>; // 1024
				touchscreen-size-y = <0x300>; // 768
				touchscreen-x-mm = <0x2b>;
				touchscreen-y-mm = <0x3a>;
				// touchscreen-swapped-x-y;
				// touchscreen-inverted-y;
			};

			ft6236@5d {
				compatible = "goodix,gt911";
				reg = <0x5d>;
				interrupt-parent = <0xffffffff>;
				interrupts = <0x1b 0x02>;
				irq-gpios = <0xffffffff 0x1b 0x02>;
				touchscreen-size-x = <0x400>; // 1024
				touchscreen-size-y = <0x300>; // 768
				touchscreen-x-mm = <0x2b>;
				touchscreen-y-mm = <0x3a>;
				// touchscreen-swapped-x-y;
				// touchscreen-inverted-y;
			};
		};
	};

	__overrides__ {
		touchscreen-inverted-x = [00 00 00 00 2b 32 00];
		touchscreen-inverted-y = [00 00 00 00 2d 33 00];
		touchscreen-swapped-x-y = [00 00 00 00 2d 31 00];
	};

	__fixups__ {
		gpio = "/fragment@1/__overlay__/i2c@0:gpios:0", "/fragment@1/__overlay__/i2c@0:gpios:12", "/fragment@2/__overlay__/ft6236@14:interrupt-parent:0", "/fragment@2/__overlay__/ft6236@14:irq-gpios:0", "/fragment@2/__overlay__/ft6236@5d:interrupt-parent:0", "/fragment@2/__overlay__/ft6236@5d:irq-gpios:0";
	};

	__local_fixups__ {

		fragment@2 {
			target = <0x00>;
		};
	};
};
